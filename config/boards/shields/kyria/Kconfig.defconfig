## config/boards/shields/kyria/Kconfig.defconfig
```kconfig
if SHIELD_KYRIA_REV3_D_RIGHT

config ZMK_KEYBOARD_NAME
    default "Kyria"

config ZMK_SPLIT_ROLE_CENTRAL
    default y

endif

if SHIELD_KYRIA

config ZMK_SPLIT
    default y

endif
```

## config/boards/shields/kyria/Kconfig.shield
```kconfig
config SHIELD_KYRIA
    bool

config SHIELD_KYRIA_REV3_D_LEFT
    def_bool $(shields_list_contains,kyria_rev3_d_left)
    select SHIELD_KYRIA

config SHIELD_KYRIA_REV3_D_RIGHT
    def_bool $(shields_list_contains,kyria_rev3_d_right)
    select SHIELD_KYRIA

config SHIELD_KYRIA_REV3_D_DONGLE
    def_bool $(shields_list_contains,kyria_rev3_d_dongle)
    select SHIELD_KYRIA
```
